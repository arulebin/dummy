#include "msm8953-audio_rosy.dtsi"
#include "msm8953-qrd_rosy.dtsi"
#include "msm8953-mdss-panels_rosy.dtsi"
#include "msm8953-camera-sensor-qrd_rosy.dtsi"
#include "msm8953-pinctrl_rosy.dtsi"
#include "msm8953_rosy.dtsi"
#include "msm8953-qrd-sku3_rosy.dtsi"
